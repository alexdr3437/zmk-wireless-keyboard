## boards/arm/custom_wireless/Kconfig
```kconfig
#
# Copyright (c) 2022 The ZMK Contributors
# SPDX-License-Identifier: MIT
#

config BOARD_CUSTOM_WIRELESS_LEFT
    bool

config BOARD_CUSTOM_WIRELESS_RIGHT
    bool
```

## boards/arm/custom_wireless/Kconfig.board
```kconfig
#
# Copyright (c) 2022 Darryl deHaan
# SPDX-License-Identifier: MIT
#

config BOARD_CUSTOM_WIRELESS_LEFT
    bool "corneish zen left v1"
    depends on SOC_NRF52840_QIAA

config BOARD_CUSTOM_WIRELESS_RIGHT
    bool "corneish zen right v1"
    depends on SOC_NRF52840_QIAA
```

## boards/arm/custom_wireless/Kconfig.defconfig
```kconfig
#
# Copyright (c) 2022 Darryl deHaan
# SPDX-License-Identifier: MIT
#

if BOARD_CUSTOM_WIRELESS_RIGHT

config ZMK_KEYBOARD_NAME
    default "Custom Wireless"

config ZMK_SPLIT_ROLE_CENTRAL
    default y

endif # BOARD_CUSTOM_WIRELESS_RIGHT


if BOARD_CUSTOM_WIRELESS_LEFT || BOARD_CUSTOM_WIRELESS_RIGHT

config BOARD
    default "custom_wireless"

config ZMK_SPLIT
    default y

config BT_CTLR
    default BT

if USB

config USB_NRFX
    default y

config USB_DEVICE_STACK
    default y

endif # USB

menuconfig CUSTOM_WIDGET_BATTERY_STATUS
    bool "custom battery status widget"

menuconfig CUSTOM_WIDGET_OUTPUT_STATUS
    bool "custom output status widget"

menuconfig CUSTOM_WIDGET_LAYER_STATUS
    bool "custom layer status widget"

menuconfig CUSTOM_WIDGET_PERIPHERAL_STATUS
    bool "custom peripheral status widget"

endif # BOARD_CUSTOM_WIRELESS_LEFT || BOARD_CUSTOM_WIRELESS_RIGHT
```

## boards/arm/custom_wireless/custom_wireless_left_defconfig
```kconfig
# Turn on logging, and set ZMK logging to debug output
# CONFIG_ZMK_USB_LOGGING=y
#

# board
CONFIG_SOC_SERIES_NRF52X=y
CONFIG_SOC_NRF52840_QIAA=y
CONFIG_GPIO=y
CONFIG_PINCTRL=y
CONFIG_USE_DT_CODE_PARTITION=y
CONFIG_NRFX_GPIOTE_NUM_OF_EVT_HANDLERS=1
CONFIG_ARM_MPU=y
CONFIG_CLOCK_CONTROL_NRF_K32SRC_30PPM=y
CONFIG_ENTROPY_NRF5_THR_THRESHOLD=4
CONFIG_ENTROPY_NRF5_ISR_THRESHOLD=12
CONFIG_CLOCK_CONTROL_NRF_K32SRC_XTAL=y
CONFIG_CLOCK_CONTROL_NRF_K32SRC_30PPM=y

# transports 
CONFIG_ZMK_USB=y
CONFIG_ZMK_BLE=y

# stack sizes 
CONFIG_SYSTEM_WORKQUEUE_STACK_SIZE=8192
CONFIG_ZMK_BLE_THREAD_STACK_SIZE=8192
CONFIG_LOG_PROCESS_THREAD_STACK_SIZE=8192
CONFIG_ZMK_SPLIT_BLE_CENTRAL_SPLIT_RUN_STACK_SIZE=8192

# zmk
CONFIG_ZMK_SPLIT_ROLE_CENTRAL=y
CONFIG_ZMK_SLEEP=y

# logging
CONFIG_ZMK_USB_LOGGING=y
CONFIG_ZMK_LOG_LEVEL_DBG=y
CONFIG_SEGGER_RTT_BUFFER_SIZE_UP=8192
CONFIG_LOG_BUFFER_SIZE=65536
CONFIG_USE_SEGGER_RTT=y
CONFIG_CONSOLE_INIT_PRIORITY=40
CONFIG_RTT_CONSOLE=y

# flash
CONFIG_FLASH=y
CONFIG_NVS=y
CONFIG_SETTINGS_NVS_NAME_CACHE=y
CONFIG_FLASH_MAP=y
CONFIG_BUILD_OUTPUT_UF2=y

# debug
CONFIG_DEBUG=n
CONFIG_ASSERT=n
```

## config/west.yml
```yaml
manifest:
  remotes:
    - name: zmkfirmware
      url-base: https://github.com/zmkfirmware
    - name: nrfconnect 
      url-base: https://github.com/nrfconnect
    # Additional modules containing boards/shields/custom code can be listed here as well
    # See https://docs.zephyrproject.org/3.2.0/develop/west/manifest.html#projects
  projects:
    - name: zmk
      remote: zmkfirmware
      revision: main
      import: app/west.yml
    - name: sdk-nrf
      path: nrf
      revision: v2.6-branch
      remote: nrfconnect 
      import:
        # Please keep this list sorted alphabetically.
        name-blocklist:
          - Alexa-Gadgets-Embedded-Sample-Code
          - canopennode
          - cirrus
          - civetweb
          - connectedhomeip
          - find-my
          - hal_st
          - homekit
          - loramac-node
          - lvgl
          - matter
          - mbed-cloud-client
          - nrf-802154
          - openthread
          - sdk-lc3
  self:
    path: config
```

## west.yml
```yaml
manifest:
  remotes:
  projects:
  self:
    west-commands: scripts/west-commands.yml
```

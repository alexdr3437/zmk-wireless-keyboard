/*
*
* Copyright (c) 2021 Darryl deHaan
* SPDX-License-Identifier: MIT
*
*/

#include "custom_wireless.dtsi"

/{
    kscan0: kscan {
        compatible = "zmk,kscan-gpio-direct";
        wakeup-source;
        input-gpios
            = <&gpio0 25 (GPIO_ACTIVE_LOW | GPIO_PULL_UP)>
            , <&gpio0 23 (GPIO_ACTIVE_LOW | GPIO_PULL_UP)>
            , <&gpio0 21 (GPIO_ACTIVE_LOW | GPIO_PULL_UP)>
            , <&gpio0 19 (GPIO_ACTIVE_LOW | GPIO_PULL_UP)>
            , <&gpio0 16 (GPIO_ACTIVE_LOW | GPIO_PULL_UP)>
            , <&gpio0 14 (GPIO_ACTIVE_LOW | GPIO_PULL_UP)>
            , <&gpio0 12 (GPIO_ACTIVE_LOW | GPIO_PULL_UP)>
            , <&gpio1 9  (GPIO_ACTIVE_LOW | GPIO_PULL_UP)>
            , <&gpio0 8  (GPIO_ACTIVE_LOW | GPIO_PULL_UP)>
            , <&gpio0 6  (GPIO_ACTIVE_LOW | GPIO_PULL_UP)>
            , <&gpio0 26 (GPIO_ACTIVE_LOW | GPIO_PULL_UP)>
            , <&gpio0 4  (GPIO_ACTIVE_LOW | GPIO_PULL_UP)>
            , <&gpio1 8  (GPIO_ACTIVE_LOW | GPIO_PULL_UP)>
            , <&gpio0 28 (GPIO_ACTIVE_LOW | GPIO_PULL_UP)>
            , <&gpio0 7  (GPIO_ACTIVE_LOW | GPIO_PULL_UP)>
            , <&gpio1 14 (GPIO_ACTIVE_LOW | GPIO_PULL_UP)>
            , <&gpio1 11 (GPIO_ACTIVE_LOW | GPIO_PULL_UP)>
            , <&gpio1 12 (GPIO_ACTIVE_LOW | GPIO_PULL_UP)>
            , <&gpio1 10 (GPIO_ACTIVE_LOW | GPIO_PULL_UP)>
            , <&gpio1 13 (GPIO_ACTIVE_LOW | GPIO_PULL_UP)>
            , <&gpio0 29 (GPIO_ACTIVE_LOW | GPIO_PULL_UP)>
            , <&gpio0 31 (GPIO_ACTIVE_LOW | GPIO_PULL_UP)>
            , <&gpio1 15 (GPIO_ACTIVE_LOW | GPIO_PULL_UP)>
            , <&gpio0 2  (GPIO_ACTIVE_LOW | GPIO_PULL_UP)>
            ;
    };

};

&default_transform {
    col-offset = <24>;
};
